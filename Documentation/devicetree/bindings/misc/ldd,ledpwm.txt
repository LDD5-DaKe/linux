## Documentation/devicetree/bindings/misc/ldd,ledpwm.txt
```
* HSD/LDD5 FH-Hagenberg ledpwm device controller

This file describes the bindings for the ledpwm device for
LDD5 assignment 3.
The instantiated driver will be able to control the brightness of
a single led.

Required properties for the driver:
- reg: address of the register of the led to control, length should always be 1
- compatible: must be "ldd,ledpwm"!

Example:
ledpwm0: ledpwm@0xff203080 {
	compatible = "ldd,ledpwm";
	reg = <0xff203080 0x1>;
};
```

## Documentation/devicetree/bindings/misc/ldd,pushbutton.txt
```
* HSD/LDD5 FH-Hagenberg pushbutton device controller

This file describes the bindings for the pushbutton device for
LDD5 assignment 4.
The instantiated driver will be able to control the brightness of
a single led.

Required properties for the driver:
- reg: address of the register of the pushbutton control
- compatible: must be "ldd,pushbutton"!
- interrupts: configuration for the desired behaviour
- interrupt-parent: interrupt controller

Example:
pushbuttons: pushbutton@0xff200050 {
	compatible = "ldd,pushbutton";
	reg = <0xff200050 0x4>;
	interrupts = <0x0 0x29 0x4>; // level triggered shared peripheral interrupt
	interrupt-parent = <&intc>;
};
```
